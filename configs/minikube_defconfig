## configs/minikube_defconfig
```kconfig
BR2_x86_64=y
BR2_CCACHE=y
BR2_TOOLCHAIN_BUILDROOT_VENDOR="minikube"
BR2_TOOLCHAIN_BUILDROOT_GLIBC=y
BR2_TOOLCHAIN_BUILDROOT_CXX=y
BR2_TARGET_GENERIC_HOSTNAME="minikube"
BR2_TARGET_GENERIC_ISSUE="Welcome to minikube"
BR2_TARGET_GENERIC_PASSWD_SHA512=y
BR2_INIT_SYSTEMD=y
BR2_SYSTEM_BIN_SH_BASH=y
# BR2_TARGET_GENERIC_GETTY is not set
BR2_ROOTFS_USERS_TABLES="$(BR2_EXTERNAL)/board/coreos/minikube/users"
BR2_ROOTFS_OVERLAY="$(BR2_EXTERNAL)/board/coreos/minikube/rootfs-overlay"
BR2_LINUX_KERNEL=y
BR2_LINUX_KERNEL_USE_CUSTOM_CONFIG=y
BR2_LINUX_KERNEL_CUSTOM_CONFIG_FILE="$(BR2_EXTERNAL)/board/coreos/minikube/linux-4.7_defconfig"
BR2_PACKAGE_XZ=y
BR2_PACKAGE_E2FSPROGS=y
BR2_PACKAGE_PARTED=y
BR2_PACKAGE_CA_CERTIFICATES=y
BR2_PACKAGE_LIBFUSE=y
BR2_PACKAGE_BRIDGE_UTILS=y
BR2_PACKAGE_IPROUTE2=y
BR2_PACKAGE_IPTABLES=y
BR2_PACKAGE_OPENSSH=y
BR2_PACKAGE_SOCAT=y
BR2_PACKAGE_SUDO=y
BR2_PACKAGE_ACL=y
BR2_PACKAGE_OPENVMTOOLS=y
BR2_PACKAGE_OPENVMTOOLS_PROCPS=y
# BR2_PACKAGE_SYSTEMD_HWDB is not set
BR2_PACKAGE_SYSTEMD_LOGIND=y
BR2_PACKAGE_SYSTEMD_MACHINED=y
# BR2_PACKAGE_SYSTEMD_TIMESYNCD is not set
BR2_PACKAGE_UTIL_LINUX_NSENTER=y
BR2_TARGET_ROOTFS_CPIO_BZIP2=y
BR2_TARGET_ROOTFS_ISO9660=y
BR2_TARGET_SYSLINUX=y
```

## deploy/iso/minikube-iso/arch/aarch64/package/Config.in
```kconfig
menu "System tools aarch64"
    source "$BR2_EXTERNAL_MINIKUBE_PATH/arch/aarch64/package/buildkit-bin-aarch64/Config.in"
    source "$BR2_EXTERNAL_MINIKUBE_PATH/arch/aarch64/package/cni-plugins-latest-aarch64/Config.in"
    source "$BR2_EXTERNAL_MINIKUBE_PATH/arch/aarch64/package/containerd-bin-aarch64/Config.in"
    source "$BR2_EXTERNAL_MINIKUBE_PATH/arch/aarch64/package/cri-dockerd-aarch64/Config.in"
    source "$BR2_EXTERNAL_MINIKUBE_PATH/arch/aarch64/package/crictl-bin-aarch64/Config.in"
    source "$BR2_EXTERNAL_MINIKUBE_PATH/arch/aarch64/package/docker-bin-aarch64/Config.in"
    source "$BR2_EXTERNAL_MINIKUBE_PATH/arch/aarch64/package/docker-buildx-aarch64/Config.in"
    source "$BR2_EXTERNAL_MINIKUBE_PATH/arch/aarch64/package/nerdctl-bin-aarch64/Config.in"
endmenu
```

## deploy/iso/minikube-iso/arch/aarch64/package/buildkit-bin-aarch64/Config.in
```kconfig
config BR2_PACKAGE_BUILDKIT_BIN_AARCH64
	bool "buildkit-bin"
	default y
	depends on BR2_aarch64
```

## deploy/iso/minikube-iso/arch/aarch64/package/cni-plugins-aarch64/Config.in
```kconfig
config BR2_PACKAGE_CNI_PLUGINS_AARCH64
	bool "cni-plugins"
	default y
	depends on BR2_aarch64
	depends on BR2_PACKAGE_HOST_GO_TARGET_ARCH_SUPPORTS
```

## deploy/iso/minikube-iso/arch/aarch64/package/cni-plugins-latest-aarch64/Config.in
```kconfig
config BR2_PACKAGE_CNI_PLUGINS_LATEST_AARCH64
	bool "cni-plugins-latest"
	default y
	depends on BR2_aarch64
	depends on BR2_PACKAGE_HOST_GO_TARGET_ARCH_SUPPORTS
```

## deploy/iso/minikube-iso/arch/aarch64/package/containerd-bin-aarch64/Config.in
```kconfig
config BR2_PACKAGE_CONTAINERD_BIN_AARCH64
	bool "containerd-bin"
	default y
	depends on BR2_aarch64
```

## deploy/iso/minikube-iso/arch/aarch64/package/cri-dockerd-aarch64/Config.in
```kconfig
config BR2_PACKAGE_CRI_DOCKERD_AARCH64
	bool "cri-dockerd"
	default y
	depends on BR2_aarch64
	depends on BR2_PACKAGE_HOST_GO_TARGET_ARCH_SUPPORTS
	depends on BR2_PACKAGE_HOST_GO_TARGET_CGO_LINKING_SUPPORTS
	depends on BR2_TOOLCHAIN_HAS_THREADS
	select BR2_PACKAGE_DOCKER_BIN
```

## deploy/iso/minikube-iso/arch/aarch64/package/docker-bin-aarch64/Config.in
```kconfig
config BR2_PACKAGE_DOCKER_BIN_AARCH64
	bool "docker-bin"
	default y
	depends on BR2_aarch64
```

## deploy/iso/minikube-iso/arch/aarch64/package/docker-buildx-aarch64/Config.in
```kconfig
config BR2_PACKAGE_DOCKER_BUILDX_AARCH64
        bool "docker-buildx"
        default y
        depends on BR2_aarch64
```

## deploy/iso/minikube-iso/arch/aarch64/package/nerdctl-bin-aarch64/Config.in
```kconfig
config BR2_PACKAGE_NERDCTL_BIN_AARCH64
        bool "nerdctl-bin"
        default y
        depends on BR2_aarch64
```

## deploy/iso/minikube-iso/arch/aarch64/package/nerdctld-bin-aarch64/Config.in
```kconfig
config BR2_PACKAGE_NERDCTLD_BIN_AARCH64
        bool "nerdctld-bin"
        default y
        depends on BR2_aarch64
```

## deploy/iso/minikube-iso/arch/x86_64/package/Config.in
```kconfig
menu "System tools x86_64"
    source "$BR2_EXTERNAL_MINIKUBE_PATH/arch/x86_64/package/buildkit-bin/Config.in"
    source "$BR2_EXTERNAL_MINIKUBE_PATH/arch/x86_64/package/cni-plugins-latest/Config.in"
    source "$BR2_EXTERNAL_MINIKUBE_PATH/arch/x86_64/package/containerd-bin/Config.in"
    source "$BR2_EXTERNAL_MINIKUBE_PATH/arch/x86_64/package/cri-dockerd/Config.in"
    source "$BR2_EXTERNAL_MINIKUBE_PATH/arch/x86_64/package/crictl-bin/Config.in"
    source "$BR2_EXTERNAL_MINIKUBE_PATH/arch/x86_64/package/docker-bin/Config.in"
    source "$BR2_EXTERNAL_MINIKUBE_PATH/arch/x86_64/package/docker-buildx/Config.in"
    source "$BR2_EXTERNAL_MINIKUBE_PATH/arch/x86_64/package/hyperv-daemons/Config.in"
    source "$BR2_EXTERNAL_MINIKUBE_PATH/arch/x86_64/package/nerdctl-bin/Config.in"
    source "$BR2_EXTERNAL_MINIKUBE_PATH/arch/x86_64/package/vbox-mount-service/Config.in"
endmenu
```

## deploy/iso/minikube-iso/arch/x86_64/package/buildkit-bin/Config.in
```kconfig
config BR2_PACKAGE_BUILDKIT_BIN
	bool "buildkit-bin"
	default y
	depends on BR2_x86_64
```

## deploy/iso/minikube-iso/arch/x86_64/package/cni-plugins-latest/Config.in
```kconfig
config BR2_PACKAGE_CNI_PLUGINS_LATEST
	bool "cni-plugins-latest"
	default y
	depends on BR2_x86_64
	depends on BR2_PACKAGE_HOST_GO_TARGET_ARCH_SUPPORTS
```

## deploy/iso/minikube-iso/arch/x86_64/package/cni/Config.in
```kconfig
config BR2_PACKAGE_CNI
	bool "cni"
	default y
	depends on BR2_x86_64
	depends on BR2_PACKAGE_HOST_GO_TARGET_ARCH_SUPPORTS
```

## deploy/iso/minikube-iso/arch/x86_64/package/containerd-bin/Config.in
```kconfig
config BR2_PACKAGE_CONTAINERD_BIN
	bool "containerd-bin"
	default y
	depends on BR2_x86_64
```

## deploy/iso/minikube-iso/arch/x86_64/package/cri-dockerd/Config.in
```kconfig
config BR2_PACKAGE_CRI_DOCKERD
	bool "cri-dockerd"
	default y
	depends on BR2_x86_64
	depends on BR2_PACKAGE_HOST_GO_TARGET_ARCH_SUPPORTS
	depends on BR2_PACKAGE_HOST_GO_TARGET_CGO_LINKING_SUPPORTS
	depends on BR2_TOOLCHAIN_HAS_THREADS
	select BR2_PACKAGE_DOCKER_BIN
```

## deploy/iso/minikube-iso/arch/x86_64/package/crictl-bin/Config.in
```kconfig
config BR2_PACKAGE_CRICTL_BIN
	bool "crictl-bin"
	default y
	depends on BR2_x86_64
```

## deploy/iso/minikube-iso/arch/x86_64/package/criu/Config.in
```kconfig
config BR2_PACKAGE_CRICTL_BIN
	bool "criu"
	default y
	depends on BR2_x86_64
    depends on BR2_PACKAGE_LIBCAP
    depends on BR2_PACKAGE_PROTOBUF
    depends on BR2_PACKAGE_PROTOBUF_C
    depends on BR2_PACKAGE_LIBNL
    depends on BR2_PACKAGE_LIBNET
```

## deploy/iso/minikube-iso/arch/x86_64/package/docker-bin/Config.in
```kconfig
config BR2_PACKAGE_DOCKER_BIN
	bool "docker-bin"
	default y
	depends on BR2_x86_64
```

## deploy/iso/minikube-iso/arch/x86_64/package/docker-buildx/Config.in
```kconfig
config BR2_PACKAGE_DOCKER_BUILDX
        bool "docker-buildx"
        default y
        depends on BR2_x86_64
```

## deploy/iso/minikube-iso/arch/x86_64/package/nerdctl-bin/Config.in
```kconfig
config BR2_PACKAGE_NERDCTL_BIN
        bool "nerdctl-bin"
        default y
        depends on BR2_x86_64
```

## deploy/iso/minikube-iso/arch/x86_64/package/nerdctld-bin/Config.in
```kconfig
config BR2_PACKAGE_NERDCTLD_BIN
        bool "nerdctld-bin"
        default y
        depends on BR2_x86_64
```

## deploy/iso/minikube-iso/arch/x86_64/package/vbox-guest/Config.in
```kconfig
config BR2_PACKAGE_VBOX_GUEST
	bool "vbox-guest"
	depends on BR2_x86_64
	depends on BR2_LINUX_KERNEL
```
