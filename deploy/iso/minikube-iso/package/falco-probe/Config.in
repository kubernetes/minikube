## deploy/iso/minikube-iso/package/falco-probe/Config.in
```kconfig
config BR2_PACKAGE_FALCO_PROBE
	bool "falco-probe"
	default y
	depends on BR2_LINUX_KERNEL
	select BR2_PACKAGE_NCURSES
	select BR2_PACKAGE_LIBYAML
```

## deploy/iso/minikube-iso/package/gluster/Config.in
```kconfig
config BR2_PACKAGE_GLUSTER
	bool "gluster"
	default y
	select BR2_PACKAGE_LIBURCU
	select BR2_PACKAGE_LIBXML2
	help
	  Gluster is a scalable, distributed file system that
	  aggregates disk storage resources from multiple servers into
	  a single global namespace.

	  https://www.gluster.org/
```

## deploy/iso/minikube-iso/package/hv-fcopy-daemon/Config.in
```kconfig
config BR2_PACKAGE_HV_FCOPY_DAEMON
	bool "hv-fcopy-daemon"
	default y
	depends on BR2_x86_64
```

## deploy/iso/minikube-iso/package/hv-kvp-daemon/Config.in
```kconfig
config BR2_PACKAGE_HV_KVP_DAEMON
	bool "hv-kvp-daemon"
	default y
	depends on BR2_x86_64
```

## deploy/iso/minikube-iso/package/hv-vss-daemon/Config.in
```kconfig
config BR2_PACKAGE_HV_VSS_DAEMON
	bool "hv-vss-daemon"
	default y
	depends on BR2_x86_64
```

## deploy/iso/minikube-iso/package/hyperv-daemons/Config.in
```kconfig
config BR2_PACKAGE_HYPERV_DAEMONS
	bool "hyperv-daemons"
	depends on BR2_x86_64
	default y
```

## deploy/iso/minikube-iso/package/open-iscsi/Config.in
```kconfig
config BR2_PACKAGE_OPEN_ISCSI
	bool "open-iscsi"
	default y
	depends on BR2_PACKAGE_KMOD
	depends on BR2_PACKAGE_OPEN_ISNS
	select BR2_PACKAGE_BERKELEYDB
```

## deploy/iso/minikube-iso/package/openvmtools10/Config.in
```kconfig
config BR2_PACKAGE_OPENVMTOOLS10
	bool "openvmtools10"
	depends on BR2_i386 || BR2_x86_64
	depends on BR2_USE_MMU # libglib2
	depends on BR2_USE_WCHAR # libglib2
	depends on BR2_TOOLCHAIN_HAS_THREADS # libglib2
	depends on BR2_TOOLCHAIN_HAS_NATIVE_RPC
	depends on BR2_ENABLE_LOCALE
	depends on !BR2_TOOLCHAIN_USES_UCLIBC
	select BR2_PACKAGE_LIBGLIB2
	select BR2_PACKAGE_LIBDNET
	help
	  Open Virtual Machine Tools for VMware guest OS

	  http://open-vm-tools.sourceforge.net/

	  ICU locales, Xerces, and X11 tools are currently not supported.

	  NOTE: Support for vmblock-fuse will be enabled in openvmtools if the
		libfuse package is selected.

if BR2_PACKAGE_OPENVMTOOLS10

config BR2_PACKAGE_OPENVMTOOLS10_PROCPS
	bool "procps support"
	depends on BR2_PACKAGE_BUSYBOX_SHOW_OTHERS
	select BR2_PACKAGE_PROCPS_NG
	help
	  Enable support for procps / meminfo

comment "procps support needs BR2_PACKAGE_BUSYBOX_SHOW_OTHERS"
	depends on !BR2_PACKAGE_BUSYBOX_SHOW_OTHERS

config BR2_PACKAGE_OPENVMTOOLS10_PAM
	bool "PAM support"
	select BR2_PACKAGE_LINUX_PAM
	# linux-pam needs locale and wchar, but we already have this
	# dependency on the main symbol, above.
	depends on !BR2_STATIC_LIBS
	depends on !BR2_TOOLCHAIN_USES_MUSL # linux-pam
	help
	  Support for PAM in openvmtools

comment "PAM support needs a glibc toolchain w/ dynamic library"
	depends on BR2_STATIC_LIBS || BR2_TOOLCHAIN_USES_MUSL

endif

comment "openvmtools needs a glibc or musl toolchain w/ wchar, threads, RPC, locale"
	depends on BR2_i386 || BR2_x86_64
	depends on BR2_USE_MMU
	depends on !BR2_USE_WCHAR || !BR2_TOOLCHAIN_HAS_THREADS || \
		!BR2_TOOLCHAIN_HAS_NATIVE_RPC || !BR2_ENABLE_LOCALE || \
		BR2_TOOLCHAIN_USES_UCLIBC
```

## deploy/iso/minikube-iso/package/pahole/Config.in.host
```kconfig
config BR2_PACKAGE_HOST_PAHOLE
	bool "host pahole"
	default y
	help
	  Pahole and other DWARF utils.

	  https://git.kernel.org/pub/scm/devel/pahole/pahole.git
```

## deploy/iso/minikube-iso/package/podman/Config.in
```kconfig
config BR2_PACKAGE_PODMAN
	bool "podman"
	default y
	depends on BR2_x86_64
	depends on BR2_PACKAGE_HOST_GO_ARCH_SUPPORTS
	depends on BR2_PACKAGE_HOST_GO_CGO_LINKING_SUPPORTS
	depends on BR2_TOOLCHAIN_HAS_THREADS
	select BR2_PACKAGE_LIBSECCOMP
	select BR2_PACKAGE_LIBGPGME
```

## deploy/iso/minikube-iso/package/rktlet-master/Config.in
```kconfig
config BR2_PACKAGE_RKTLET_MASTER
	bool "rktlet-master"
        default y
	depends on BR2_PACKAGE_HOST_GO_ARCH_SUPPORTS
	depends on BR2_PACKAGE_HOST_GO_CGO_LINKING_SUPPORTS
	depends on BR2_TOOLCHAIN_HAS_THREADS
	help
	  The rkt implementation of the Kubernetes
          Container Runtime Interface.

	  https://github.com/kubernetes-incubator/rktlet

comment "rktlet needs a toolchain w/ threads"
	depends on BR2_PACKAGE_HOST_GO_ARCH_SUPPORTS && \
		BR2_PACKAGE_HOST_GO_CGO_LINKING_SUPPORTS
	depends on !BR2_TOOLCHAIN_HAS_THREADS
```

## deploy/iso/minikube-iso/package/runc-master/Config.in
```kconfig
config BR2_PACKAGE_RUNC_MASTER
	bool "runc-master"
	depends on BR2_PACKAGE_HOST_GO_TARGET_ARCH_SUPPORTS
	depends on BR2_PACKAGE_HOST_GO_TARGET_CGO_LINKING_SUPPORTS
	depends on BR2_TOOLCHAIN_HAS_THREADS
	help
	  runC is a CLI tool for spawning and running containers
	  according to the OCP specification.

	  This is just a newer build of runc than the buildroot version.

	  https://github.com/opencontainers/runc

comment "runc needs a toolchain w/ threads"
	depends on BR2_PACKAGE_HOST_GO_TARGET_ARCH_SUPPORTS && \
		BR2_PACKAGE_HOST_GO_TARGET_CGO_LINKING_SUPPORTS
	depends on !BR2_TOOLCHAIN_HAS_THREADS
```

## deploy/iso/minikube-iso/package/scheduled-stop/Config.in
```kconfig
config BR2_PACKAGE_SCHEDULED_STOP
	bool "scheduled-stop"
	depends on BR2_x86_64
	default y
```

## deploy/iso/minikube-iso/package/sysdig/Config.in
```kconfig
config BR2_PACKAGE_SYSDIG
	bool "sysdig"
	depends on BR2_LINUX_KERNEL
	depends on BR2_INSTALL_LIBSTDCPP # jsoncpp
	depends on BR2_TOOLCHAIN_GCC_AT_LEAST_4_8
	depends on BR2_TOOLCHAIN_HAS_THREADS # elfutils, jq
	depends on !BR2_STATIC_LIBS # elfutils
	depends on BR2_USE_WCHAR # elfutils
	depends on BR2_TOOLCHAIN_USES_UCLIBC || BR2_TOOLCHAIN_USES_GLIBC # elfutils
	depends on BR2_PACKAGE_LUAINTERPRETER_ABI_VERSION_5_1
	select BR2_PACKAGE_C_ARES
	select BR2_PACKAGE_ELFUTILS
	select BR2_PACKAGE_GRPC
	select BR2_PACKAGE_GTEST
	select BR2_PACKAGE_JQ
	select BR2_PACKAGE_JSONCPP
	select BR2_PACKAGE_LIBB64
	select BR2_PACKAGE_LIBCURL
	select BR2_PACKAGE_NCURSES
	select BR2_PACKAGE_OPENSSL
	select BR2_PACKAGE_PROTOBUF
	select BR2_PACKAGE_TBB
	select BR2_PACKAGE_ZLIB
	help
	  Sysdig is open source, system-level exploration:
	  capture system state and activity from a running Linux
	  instance, then save, filter and analyze.
	  Think of it as strace + tcpdump + lsof + awesome sauce.
	  With a little Lua cherry on top.

	  https://github.com/draios/sysdig/wiki

comment "sysdig needs a glibc or uclibc toolchain w/ C++, threads, gcc >= 4.8, dynamic library, a Linux kernel, and luajit or lua 5.1 to be built"
	depends on !BR2_LINUX_KERNEL || !BR2_INSTALL_LIBSTDCPP \
		|| !BR2_TOOLCHAIN_HAS_THREADS \
		|| !BR2_TOOLCHAIN_GCC_AT_LEAST_4_8 || BR2_STATIC_LIBS \
		|| !(BR2_TOOLCHAIN_USES_UCLIBC || BR2_TOOLCHAIN_USES_GLIBC) \
	    || !BR2_PACKAGE_LUAINTERPRETER_ABI_VERSION_5_1
```

## deploy/iso/minikube-iso/package/tbb/Config.in
```kconfig
config BR2_PACKAGE_TBB
	bool "tbb"
	depends on BR2_TOOLCHAIN_USES_GLIBC
	depends on !BR2_STATIC_LIBS
	depends on BR2_TOOLCHAIN_HAS_THREADS
	depends on BR2_INSTALL_LIBSTDCPP
	help
	  Intel(R) Threading Building Blocks (Intel(R) TBB) lets you
	  easily write parallel C++ programs that take full advantage
	  of multicore performance, that are portable, composable and
	  have future-proof scalability.

	  https://www.threadingbuildingblocks.org/

comment "tbb needs a glibc toolchain w/ dynamic library, threads, C++"
	depends on !BR2_TOOLCHAIN_USES_GLIBC || BR2_STATIC_LIBS || !BR2_TOOLCHAIN_HAS_THREADS || !BR2_INSTALL_LIBSTDCPP
```
