## deploy/iso/minikube-iso/configs/minikube_defconfig
```kconfig
# Architecture
BR2_x86_64=y

# Toolchain
BR2_TOOLCHAIN_BUILDROOT_WCHAR=y

# System
BR2_SYSTEM_DHCP="eth0"

# Required tools to create bootable media
BR2_PACKAGE_HOST_DOSFSTOOLS=y
BR2_PACKAGE_HOST_GENIMAGE=y
BR2_PACKAGE_HOST_MTOOLS=y

# Bootloader
BR2_TARGET_GRUB2=y
BR2_TARGET_GRUB2_X86_64_EFI=y
BR2_TARGET_GRUB2_BUILTIN_CONFIG="$(BR2_EXTERNAL_MINIKUBE_PATH)/board/iso/x86_64/grub-stub.cfg"
BR2_TARGET_GRUB2_BUILTIN_MODULES="boot linux ext2 fat squash4 part_msdos part_gpt normal efi_gop udf iso9660 search search_fs_file search_fs_uuid search_label"

# Filesystem / image
BR2_TARGET_ROOTFS_CPIO=y
BR2_TARGET_ROOTFS_CPIO_GZIP=y
BR2_ROOTFS_POST_BUILD_SCRIPT="$(BR2_EXTERNAL_MINIKUBE_PATH)/board/iso/x86_64/post-build.sh"
BR2_ROOTFS_POST_IMAGE_SCRIPT="$(BR2_EXTERNAL_MINIKUBE_PATH)/board/iso/x86_64/post-image.sh"
BR2_ROOTFS_POST_SCRIPT_ARGS="$(BR2_EXTERNAL_MINIKUBE_PATH)/board/iso/x86_64/genimage.cfg"

# Linux headers same as kernel, a 4.19 series
BR2_PACKAGE_HOST_LINUX_HEADERS_CUSTOM_4_19=y

# Kernel
BR2_LINUX_KERNEL=y
BR2_LINUX_KERNEL_CUSTOM_VERSION=y
BR2_LINUX_KERNEL_CUSTOM_VERSION_VALUE="4.19.235"
BR2_LINUX_KERNEL_USE_ARCH_DEFAULT_CONFIG=y
BR2_LINUX_KERNEL_NEEDS_HOST_OPENSSL=y

BR2_CCACHE=y

# Packages
BR2_PACKAGE_ACPID=y

# Minikube

BR2_OPTIMIZE_2=y
BR2_GLOBAL_PATCH_DIR="$(BR2_EXTERNAL_MINIKUBE_PATH)/board/coreos/minikube/patches"
BR2_TOOLCHAIN_BUILDROOT_VENDOR="minikube"
BR2_TOOLCHAIN_BUILDROOT_GLIBC=y
BR2_TOOLCHAIN_BUILDROOT_CXX=y
BR2_GCC_ENABLE_LTO=y
BR2_TARGET_GENERIC_HOSTNAME="minikube"
BR2_TARGET_GENERIC_ISSUE="Welcome to minikube"
BR2_TARGET_GENERIC_PASSWD_SHA512=y
BR2_INIT_SYSTEMD=y
BR2_ROOTFS_DEVICE_TABLE="$(BR2_EXTERNAL_MINIKUBE_PATH)/board/coreos/minikube/permissions"
BR2_SYSTEM_BIN_SH_BASH=y
BR2_ROOTFS_USERS_TABLES="$(BR2_EXTERNAL_MINIKUBE_PATH)/board/coreos/minikube/users"
BR2_ROOTFS_OVERLAY="$(BR2_EXTERNAL_MINIKUBE_PATH)/board/coreos/minikube/rootfs-overlay"
BR2_LINUX_KERNEL_USE_CUSTOM_CONFIG=y
BR2_LINUX_KERNEL_CUSTOM_CONFIG_FILE="$(BR2_EXTERNAL_MINIKUBE_PATH)/board/coreos/minikube/linux_defconfig"
BR2_LINUX_KERNEL_LZ4=y
BR2_LINUX_KERNEL_NEEDS_HOST_LIBELF=y
BR2_PACKAGE_GZIP=y
BR2_PACKAGE_XZ=y
BR2_PACKAGE_STRACE=y
BR2_PACKAGE_SYSDIG=y
BR2_PACKAGE_FINDUTILS=y
BR2_PACKAGE_GIT=y
BR2_PACKAGE_CIFS_UTILS=y
BR2_PACKAGE_E2TOOLS=y
BR2_PACKAGE_NFS_UTILS=y
BR2_PACKAGE_SSHFS=y
BR2_PACKAGE_XFSPROGS=y
BR2_PACKAGE_PARTED=y
BR2_PACKAGE_SYSSTAT=y
BR2_PACKAGE_LUAJIT=y
BR2_PACKAGE_LZ4=y
BR2_PACKAGE_LZ4_PROGS=y
BR2_PACKAGE_CA_CERTIFICATES=y
BR2_PACKAGE_LIBOPENSSL_BIN=y
BR2_PACKAGE_LIBCURL_CURL=y
BR2_PACKAGE_BRIDGE_UTILS=y
BR2_PACKAGE_CONNTRACK_TOOLS=y
BR2_PACKAGE_EBTABLES=y
BR2_PACKAGE_ETHTOOL=y
BR2_PACKAGE_IPROUTE2=y
BR2_PACKAGE_IPTABLES=y
BR2_PACKAGE_RSYNC=y
BR2_PACKAGE_SOCAT=y
BR2_PACKAGE_SUDO=y
BR2_PACKAGE_ACL=y
BR2_PACKAGE_COREUTILS=y
BR2_PACKAGE_HTOP=y
BR2_PACKAGE_OPENVMTOOLS=y
BR2_PACKAGE_PROCPS_NG=y
BR2_PACKAGE_PSMISC=y
BR2_PACKAGE_SYSTEMD_LOGIND=y
BR2_PACKAGE_SYSTEMD_MACHINED=y
BR2_PACKAGE_TAR=y
BR2_PACKAGE_UTIL_LINUX_BINARIES=y
BR2_PACKAGE_UTIL_LINUX_LOSETUP=y
BR2_PACKAGE_UTIL_LINUX_NOLOGIN=y
BR2_PACKAGE_UTIL_LINUX_NSENTER=y
BR2_PACKAGE_UTIL_LINUX_SCHEDUTILS=y
BR2_TARGET_ROOTFS_ISO9660=y
BR2_TARGET_ROOTFS_ISO9660_BOOT_MENU="$(BR2_EXTERNAL_MINIKUBE_PATH)/board/coreos/minikube/isolinux.cfg"
BR2_TARGET_SYSLINUX=y
BR2_PACKAGE_HOST_E2TOOLS=y
BR2_PACKAGE_HOST_PYTHON=y
BR2_PACKAGE_LIBFUSE=y
```

## deploy/iso/minikube-iso/configs/minikube_x86_64_defconfig
```kconfig
BR2_x86_64=y
BR2_TOOLCHAIN_BUILDROOT_VENDOR="minikube"
BR2_PACKAGE_HOST_LINUX_HEADERS_CUSTOM_6_6=y
BR2_TOOLCHAIN_BUILDROOT_CXX=y
BR2_CCACHE=y
BR2_GLOBAL_PATCH_DIR="$(BR2_EXTERNAL_MINIKUBE_PATH)/patches"
BR2_TARGET_GENERIC_HOSTNAME="minikube"
BR2_TARGET_GENERIC_ISSUE="Welcome to minikube"
BR2_TARGET_GENERIC_PASSWD_SHA512=y
BR2_INIT_SYSTEMD=y
BR2_ROOTFS_DEVICE_TABLE="$(BR2_EXTERNAL_MINIKUBE_PATH)/board/minikube/x86_64/permissions"
BR2_SYSTEM_BIN_SH_BASH=y
BR2_TARGET_GENERIC_GETTY_PORT="tty1"
BR2_SYSTEM_DHCP="eth0"
BR2_ROOTFS_USERS_TABLES="$(BR2_EXTERNAL_MINIKUBE_PATH)/board/minikube/x86_64/users"
BR2_ROOTFS_OVERLAY="$(BR2_EXTERNAL_MINIKUBE_PATH)/board/minikube/x86_64/rootfs-overlay"
BR2_LINUX_KERNEL=y
BR2_LINUX_KERNEL_CUSTOM_VERSION=y
BR2_LINUX_KERNEL_CUSTOM_VERSION_VALUE="6.6.95"
BR2_LINUX_KERNEL_USE_CUSTOM_CONFIG=y
BR2_LINUX_KERNEL_CUSTOM_CONFIG_FILE="$(BR2_EXTERNAL_MINIKUBE_PATH)/board/minikube/x86_64/linux_x86_64_defconfig"
BR2_LINUX_KERNEL_LZ4=y
BR2_LINUX_KERNEL_INSTALL_TARGET=y
BR2_LINUX_KERNEL_NEEDS_HOST_OPENSSL=y
BR2_LINUX_KERNEL_NEEDS_HOST_LIBELF=y
BR2_LINUX_KERNEL_NEEDS_HOST_PAHOLE=y
BR2_PACKAGE_GZIP=y
BR2_PACKAGE_XZ=y
BR2_PACKAGE_STRACE=y
BR2_PACKAGE_FINDUTILS=y
BR2_PACKAGE_GIT=y
BR2_PACKAGE_CIFS_UTILS=y
BR2_PACKAGE_E2TOOLS=y
BR2_PACKAGE_NFS_UTILS=y
BR2_PACKAGE_SSHFS=y
BR2_PACKAGE_XFSPROGS=y
BR2_PACKAGE_ACPID=y
BR2_PACKAGE_PARTED=y
BR2_PACKAGE_SYSSTAT=y
BR2_PACKAGE_LZ4=y
BR2_PACKAGE_LZ4_PROGS=y
BR2_PACKAGE_CA_CERTIFICATES=y
BR2_PACKAGE_LIBOPENSSL_BIN=y
BR2_PACKAGE_LIBFUSE=y
BR2_PACKAGE_LIBCURL=y
BR2_PACKAGE_LIBCURL_CURL=y
BR2_PACKAGE_TBB=y
BR2_PACKAGE_BRIDGE_UTILS=y
BR2_PACKAGE_CONNTRACK_TOOLS=y
BR2_PACKAGE_EBTABLES=y
BR2_PACKAGE_ETHTOOL=y
BR2_PACKAGE_IPROUTE2=y
BR2_PACKAGE_IPTABLES=y
BR2_PACKAGE_RSYNC=y
BR2_PACKAGE_SOCAT=y
BR2_PACKAGE_SUDO=y
BR2_PACKAGE_ACL=y
BR2_PACKAGE_COREUTILS=y
BR2_PACKAGE_HTOP=y
BR2_PACKAGE_OPENVMTOOLS=y
BR2_PACKAGE_PROCPS_NG=y
BR2_PACKAGE_PSMISC=y
BR2_PACKAGE_SYSTEMD_LOGIND=y
BR2_PACKAGE_SYSTEMD_MACHINED=y
BR2_PACKAGE_TAR=y
BR2_PACKAGE_UTIL_LINUX_BINARIES=y
BR2_PACKAGE_UTIL_LINUX_LOSETUP=y
BR2_PACKAGE_UTIL_LINUX_NOLOGIN=y
BR2_PACKAGE_UTIL_LINUX_NSENTER=y
BR2_PACKAGE_UTIL_LINUX_SCHEDUTILS=y
BR2_TARGET_ROOTFS_CPIO_GZIP=y
BR2_TARGET_ROOTFS_ISO9660=y
BR2_TARGET_ROOTFS_ISO9660_BOOT_MENU="$(BR2_EXTERNAL_MINIKUBE_PATH)/board/minikube/x86_64/isolinux.cfg"
BR2_TARGET_SYSLINUX=y
BR2_PACKAGE_HOST_DOSFSTOOLS=y
BR2_PACKAGE_HOST_E2TOOLS=y
BR2_PACKAGE_HOST_GENIMAGE=y
BR2_PACKAGE_HOST_MTOOLS=y
```

## deploy/iso/minikube-iso/configs/pc_x86_64_efi_defconfig
```kconfig
# Architecture
BR2_x86_64=y

# Toolchain, required for eudev (to autoload drivers)
BR2_TOOLCHAIN_BUILDROOT_WCHAR=y

# System
BR2_TARGET_GENERIC_GETTY_PORT="tty1"
BR2_ROOTFS_DEVICE_CREATION_DYNAMIC_EUDEV=y

# Required tools to create bootable media
BR2_PACKAGE_HOST_DOSFSTOOLS=y
BR2_PACKAGE_HOST_GENIMAGE=y
BR2_PACKAGE_HOST_MTOOLS=y

# Bootloader
BR2_TARGET_GRUB2=y
BR2_TARGET_GRUB2_X86_64_EFI=y

# Filesystem / image
BR2_TARGET_ROOTFS_EXT2=y
BR2_TARGET_ROOTFS_EXT2_4=y
BR2_TARGET_ROOTFS_EXT2_SIZE="120M"
# BR2_TARGET_ROOTFS_TAR is not set
BR2_ROOTFS_POST_BUILD_SCRIPT="board/pc/post-build.sh"
BR2_ROOTFS_POST_IMAGE_SCRIPT="board/pc/post-image-efi.sh"

# Linux headers same as kernel, a 4.19 series
BR2_PACKAGE_HOST_LINUX_HEADERS_CUSTOM_4_19=y

# Kernel
BR2_LINUX_KERNEL=y
BR2_LINUX_KERNEL_CUSTOM_VERSION=y
BR2_LINUX_KERNEL_CUSTOM_VERSION_VALUE="4.19.204"
BR2_LINUX_KERNEL_USE_CUSTOM_CONFIG=y
BR2_LINUX_KERNEL_CUSTOM_CONFIG_FILE="board/pc/linux.config"
BR2_LINUX_KERNEL_INSTALL_TARGET=y
BR2_LINUX_KERNEL_NEEDS_HOST_OPENSSL=y

# Firmware
BR2_PACKAGE_LINUX_FIRMWARE=y
BR2_PACKAGE_LINUX_FIRMWARE_ATHEROS_9170=y
BR2_PACKAGE_LINUX_FIRMWARE_ATHEROS_9271=y
BR2_PACKAGE_LINUX_FIRMWARE_IWLWIFI_3160=y
BR2_PACKAGE_LINUX_FIRMWARE_IWLWIFI_3168=y
BR2_PACKAGE_LINUX_FIRMWARE_IWLWIFI_5000=y
BR2_PACKAGE_LINUX_FIRMWARE_IWLWIFI_6000G2A=y
BR2_PACKAGE_LINUX_FIRMWARE_IWLWIFI_6000G2B=y
BR2_PACKAGE_LINUX_FIRMWARE_IWLWIFI_7260=y
BR2_PACKAGE_LINUX_FIRMWARE_IWLWIFI_7265D=y
BR2_PACKAGE_LINUX_FIRMWARE_IWLWIFI_8000C=y
BR2_PACKAGE_LINUX_FIRMWARE_IWLWIFI_8265=y
BR2_PACKAGE_LINUX_FIRMWARE_RALINK_RT73=y
BR2_PACKAGE_LINUX_FIRMWARE_RALINK_RT2XX=y
BR2_PACKAGE_LINUX_FIRMWARE_RTL_8169=y
BR2_PACKAGE_LINUX_FIRMWARE_RTL_81XX=y
BR2_PACKAGE_LINUX_FIRMWARE_RTL_87XX=y
BR2_PACKAGE_LINUX_FIRMWARE_RTL_88XX=y

# Packages
#
# Use connman so that networking setup is simpler, via connmanctl tool
# acpid is for seamless power button support
BR2_PACKAGE_ACPID=y
BR2_PACKAGE_CONNMAN=y
BR2_PACKAGE_CONNMAN_CLIENT=y
BR2_PACKAGE_CONNMAN_WIFI=y
```

## deploy/iso/minikube-iso/package/Config.in
```kconfig
menu "System tools"
    source "$BR2_EXTERNAL_MINIKUBE_PATH/package/conmon/Config.in"
    source "$BR2_EXTERNAL_MINIKUBE_PATH/package/crio-bin/Config.in"
    source "$BR2_EXTERNAL_MINIKUBE_PATH/package/sysdig/Config.in"
    source "$BR2_EXTERNAL_MINIKUBE_PATH/package/crun-latest/Config.in"
    source "$BR2_EXTERNAL_MINIKUBE_PATH/package/cni/Config.in"
    source "$BR2_EXTERNAL_MINIKUBE_PATH/package/automount/Config.in"
    source "$BR2_EXTERNAL_MINIKUBE_PATH/package/gluster/Config.in"
    source "$BR2_EXTERNAL_MINIKUBE_PATH/package/falco-module/Config.in"
    source "$BR2_EXTERNAL_MINIKUBE_PATH/package/scheduled-stop/Config.in"
    source "$BR2_EXTERNAL_MINIKUBE_PATH/package/podman/Config.in"
    source "$BR2_EXTERNAL_MINIKUBE_PATH/package/runc-master/Config.in"
endmenu
```

## deploy/iso/minikube-iso/package/buildah/Config.in
```kconfig
config BR2_PACKAGE_BUILDAH
	bool "buildah"
	default y
	depends on BR2_x86_64
	depends on BR2_PACKAGE_HOST_GO_ARCH_SUPPORTS
	depends on BR2_PACKAGE_HOST_GO_CGO_LINKING_SUPPORTS
	depends on BR2_TOOLCHAIN_HAS_THREADS
	select BR2_PACKAGE_LIBSECCOMP
	select BR2_PACKAGE_LIBGPGME
	select BR2_PACKAGE_LVM2
	select BR2_PACKAGE_LIBGLIB2
```

## deploy/iso/minikube-iso/package/cni-plugins-aarch64/Config.in
```kconfig
config BR2_PACKAGE_CNI_PLUGINS
	bool "cni-plugins"
	default y
	depends on BR2_aarch64
```

## deploy/iso/minikube-iso/package/cni-plugins-bin/Config.in
```kconfig
config BR2_PACKAGE_CNI_PLUGINS_BIN
	bool "cni-plugins-bin"
	default y
	depends on BR2_x86_64
```

## deploy/iso/minikube-iso/package/cni-plugins/Config.in
```kconfig
config BR2_PACKAGE_CNI_PLUGINS
	bool "cni-plugins"
	default y
	depends on BR2_x86_64
	depends on BR2_PACKAGE_HOST_GO_TARGET_ARCH_SUPPORTS
```

## deploy/iso/minikube-iso/package/conmon-latest/Config.in
```kconfig
config BR2_PACKAGE_CONMON_LATEST
	bool "conmon-latest"
	depends on BR2_TOOLCHAIN_HAS_THREADS # libglib2
	depends on BR2_USE_MMU # libglib2
	depends on BR2_USE_WCHAR # libglib2
	select BR2_PACKAGE_LIBGLIB2
	help
	  Conmon is an OCI container runtime monitor.

	  https://github.com/containers/conmon

comment "conmon needs a toolchain w/ threads, wchar"
	depends on !BR2_USE_WCHAR || !BR2_TOOLCHAIN_HAS_THREADS
	depends on BR2_USE_MMU
```

## deploy/iso/minikube-iso/package/conmon/Config.in
```kconfig
config BR2_PACKAGE_CONMON
	bool "conmon"
	depends on BR2_PACKAGE_HOST_GO_TARGET_ARCH_SUPPORTS
	depends on BR2_PACKAGE_HOST_GO_TARGET_CGO_LINKING_SUPPORTS
	depends on BR2_TOOLCHAIN_HAS_THREADS
	select BR2_PACKAGE_LIBGLIB2
	select BR2_PACKAGE_SYSTEMD
```

## deploy/iso/minikube-iso/package/cri-tools/Config.in
```kconfig
config BR2_PACKAGE_CRI_TOOLS
	bool "cri-tools"
	default y
	depends on BR2_PACKAGE_HOST_GO_ARCH_SUPPORTS
	depends on BR2_PACKAGE_HOST_GO_CGO_LINKING_SUPPORTS
```

## deploy/iso/minikube-iso/package/crictl-bin-aarch64/Config.in
```kconfig
config BR2_PACKAGE_CRICTL_BIN_AARCH64
	bool "crictl-bin"
	default y
	depends on BR2_aarch64
```

## deploy/iso/minikube-iso/package/crio-bin/Config.in
```kconfig
config BR2_PACKAGE_CRIO_BIN
	bool "crio-bin"
	default y
	depends on BR2_x86_64
	depends on BR2_PACKAGE_HOST_GO_TARGET_ARCH_SUPPORTS
	depends on BR2_PACKAGE_HOST_GO_TARGET_CGO_LINKING_SUPPORTS
	depends on BR2_TOOLCHAIN_HAS_THREADS
	depends on BR2_USE_MMU # lvm2
	depends on !BR2_STATIC_LIBS # lvm2
	depends on !BR2_TOOLCHAIN_USES_MUSL # lvm2
	select BR2_PACKAGE_RUNC_MASTER
	select BR2_PACKAGE_CONMON
	select BR2_PACKAGE_BTRFS_PROGS
	select BR2_PACKAGE_LIBSECCOMP
	select BR2_PACKAGE_LIBGPGME
	select BR2_PACKAGE_LVM2
	select BR2_PACKAGE_LVM2_APP_LIBRARY
	select BR2_PACKAGE_UTIL_LINUX_LIBMOUNT
	select BR2_PACKAGE_LIBGLIB2
```

## deploy/iso/minikube-iso/package/crun-latest/Config.in
```kconfig
config BR2_PACKAGE_CRUN_LATEST
	bool "crun-latest"
	select BR2_PACKAGE_YAJL
	help
	  A fast and low-memory footprint OCI Container Runtime
	  fully written in C.

	  https://github.com/containers/crun
```

## deploy/iso/minikube-iso/package/crun/Config.in
```kconfig
config BR2_PACKAGE_CRUN
	bool "crun"
	select BR2_PACKAGE_YAJL
	help
	  A fast and low-memory footprint OCI Container Runtime
	  fully written in C.

	  https://github.com/containers/crun
```

## deploy/iso/minikube-iso/package/falco-module/Config.in
```kconfig
config BR2_PACKAGE_FALCO_MODULE
	bool "falco-module"
	default n
	depends on BR2_LINUX_KERNEL
	select BR2_PACKAGE_NCURSES
	select BR2_PACKAGE_LIBYAML
```
