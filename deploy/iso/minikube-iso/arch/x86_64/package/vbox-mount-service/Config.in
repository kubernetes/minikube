## deploy/iso/minikube-iso/boot/grub2/Config.in
```kconfig
config BR2_TARGET_GRUB2_ARCH_SUPPORTS
	bool
	default y if BR2_i386
	default y if BR2_x86_64
	default y if BR2_arm
	default y if BR2_aarch64
	depends on BR2_USE_MMU

config BR2_TARGET_GRUB2
	bool "grub2"
	depends on BR2_TARGET_GRUB2_ARCH_SUPPORTS
	depends on BR2_USE_WCHAR
	select BR2_TARGET_GRUB2_I386_PC if \
		!BR2_TARGET_GRUB2_HAS_PTF && \
		(BR2_i386 || BR2_x86_64)
	select BR2_TARGET_GRUB2_ARM_UBOOT if \
		!BR2_TARGET_GRUB2_HAS_PTF && \
		BR2_arm
	select BR2_TARGET_GRUB2_ARM64_EFI if BR2_aarch64
	help
	  GNU GRUB is a Multiboot boot loader. It was derived from
	  GRUB, the GRand Unified Bootloader, which was originally
	  designed and implemented by Erich Stefan Boleyn. GRUB 2 has
	  replaced what was formerly known as GRUB (i.e. version
	  0.9x), which has, in turn, become GRUB Legacy.

	  Amongst others, GRUB2 offers EFI support, which GRUB Legacy
	  doesn't provide.

	  For additional notes on using Grub 2 with Buildroot, see
	  boot/grub2/readme.txt

	  http://www.gnu.org/software/grub/

if BR2_TARGET_GRUB2

config BR2_TARGET_GRUB2_HAS_LEGACY_BOOT
	bool

config BR2_TARGET_GRUB2_HAS_EFI_BOOT
	bool

config BR2_TARGET_GRUB2_HAS_PTF
	bool

config BR2_TARGET_GRUB2_I386_PC
	bool "i386-pc"
	depends on BR2_i386 || BR2_x86_64
	select BR2_TARGET_GRUB2_HAS_LEGACY_BOOT
	help
	  Select this option if the platform you're targetting is a
	  x86 or x86-64 legacy BIOS based platform.

config BR2_TARGET_GRUB2_I386_EFI
	bool "i386-efi"
	depends on BR2_i386 || BR2_x86_64
	select BR2_TARGET_GRUB2_HAS_PTF
	select BR2_TARGET_GRUB2_HAS_EFI_BOOT
	help
	  Select this option if the platform you're targetting has a
	  32 bits EFI BIOS. Note that some x86-64 platforms use a 32
	  bits EFI BIOS, and this option should be used in this case.

config BR2_TARGET_GRUB2_X86_64_EFI
	bool "x86-64-efi"
	depends on BR2_x86_64
	select BR2_TARGET_GRUB2_HAS_PTF
	select BR2_TARGET_GRUB2_HAS_EFI_BOOT
	help
	  Select this option if the platform you're targetting has a
	  64 bits EFI BIOS.

config BR2_TARGET_GRUB2_ARM_UBOOT
	bool "arm-uboot"
	depends on BR2_arm
	select BR2_TARGET_GRUB2_HAS_LEGACY_BOOT
	help
	  Select this option if the platform you're targetting is an
	  ARM u-boot platform, and you want to boot Grub 2 as an u-boot
	  compatible image.

config BR2_TARGET_GRUB2_ARM_EFI
	bool "arm-efi"
	depends on BR2_arm
	select BR2_TARGET_GRUB2_HAS_PTF
	select BR2_TARGET_GRUB2_HAS_EFI_BOOT
	help
	  Select this option if the platform you're targetting is an
	  ARM platform and you want to boot Grub 2 as an EFI
	  application.

config BR2_TARGET_GRUB2_ARM64_EFI
	bool "arm64-efi"
	depends on BR2_aarch64
	select BR2_TARGET_GRUB2_HAS_EFI_BOOT
	help
	  Select this option if the platform you're targetting is an
	  Aarch64 platform and you want to boot Grub 2 as an EFI
	  application.

if BR2_TARGET_GRUB2_HAS_LEGACY_BOOT

comment "Options for the x86 legacy BIOS or ARM U-Boot support"

config BR2_TARGET_GRUB2_BOOT_PARTITION
	string "boot partition"
	default "hd0,msdos1"
	help
	  Specify the partition where the /boot/grub/grub.cfg file is
	  located. Use 'hd0,msdos1' for the first partition of the
	  first disk if using a legacy partition table, or 'hd0,gpt1'
	  if using GPT partition table.

config BR2_TARGET_GRUB2_BUILTIN_MODULES_PC
	string "builtin modules"
	default BR2_TARGET_GRUB2_BUILTIN_MODULES if BR2_TARGET_GRUB2_BUILTIN_MODULES != "" # legacy
	default "boot linux ext2 fat squash4 part_msdos part_gpt normal biosdisk" if BR2_TARGET_GRUB2_I386_PC
	default "linux ext2 fat part_msdos normal" if BR2_TARGET_GRUB2_ARM_UBOOT

config BR2_TARGET_GRUB2_BUILTIN_CONFIG_PC
	string "builtin config"
	default BR2_TARGET_GRUB2_BUILTIN_CONFIG if BR2_TARGET_GRUB2_BUILTIN_CONFIG != "" # legacy
	help
	  Path to a Grub 2 configuration file that will be embedded
	  into the Grub image itself. This allows to set the root
	  device and other configuration parameters, but however menu
	  entries cannot be described in this embedded configuration.

endif # BR2_TARGET_GRUB2_HAS_LEGACY_BOOT

if BR2_TARGET_GRUB2_HAS_EFI_BOOT

comment "Options for the EFI BIOS or ARM EFI support"

config BR2_TARGET_GRUB2_BUILTIN_MODULES_EFI
	string "builtin modules"
	default BR2_TARGET_GRUB2_BUILTIN_MODULES if BR2_TARGET_GRUB2_BUILTIN_MODULES != "" # legacy
	default "boot linux ext2 fat squash4 part_msdos part_gpt normal efi_gop"

config BR2_TARGET_GRUB2_BUILTIN_CONFIG_EFI
	string "builtin config"
	default BR2_TARGET_GRUB2_BUILTIN_CONFIG if BR2_TARGET_GRUB2_BUILTIN_CONFIG != "" # legacy
	help
	  Path to a Grub 2 configuration file that will be embedded
	  into the Grub image itself. This allows to set the root
	  device and other configuration parameters, but however menu
	  entries cannot be described in this embedded configuration.

endif # BR2_TARGET_GRUB2_HAS_EFI_BOOT

config BR2_TARGET_GRUB2_INSTALL_TOOLS
	bool "install tools"
	help
	  Install support tools to interact with GNU GRUB Multiboot
	  boot loader.

	  This will also install the Grub 2 loadable modules to the
	  target.

endif # BR2_TARGET_GRUB2

comment "grub2 needs a toolchain w/ wchar"
	depends on BR2_TARGET_GRUB2_ARCH_SUPPORTS
	depends on !BR2_USE_WCHAR
```

## deploy/iso/minikube-iso/configs/iso_x86_64_defconfig
```kconfig
# Architecture
BR2_x86_64=y

# Toolchain
BR2_TOOLCHAIN_BUILDROOT_WCHAR=y

# System
BR2_SYSTEM_DHCP="eth0"

# Required tools to create bootable media
BR2_PACKAGE_HOST_DOSFSTOOLS=y
BR2_PACKAGE_HOST_GENIMAGE=y
BR2_PACKAGE_HOST_MTOOLS=y

# Bootloader
BR2_TARGET_GRUB2=y
BR2_TARGET_GRUB2_X86_64_EFI=y
BR2_TARGET_GRUB2_BUILTIN_CONFIG="$(BR2_EXTERNAL_minimal_PATH)/board/iso/x86_64/grub-stub.cfg"
BR2_TARGET_GRUB2_BUILTIN_MODULES="boot linux ext2 fat squash4 part_msdos part_gpt normal efi_gop udf iso9660 search search_fs_file search_fs_uuid search_label"

# Filesystem / image
BR2_TARGET_ROOTFS_CPIO=y
BR2_TARGET_ROOTFS_CPIO_GZIP=y
# BR2_TARGET_ROOTFS_TAR is not set
BR2_ROOTFS_POST_BUILD_SCRIPT="$(BR2_EXTERNAL_minimal_PATH)/board/iso/x86_64/post-build.sh"
BR2_ROOTFS_POST_IMAGE_SCRIPT="$(BR2_EXTERNAL_minimal_PATH)/board/iso/x86_64/post-image.sh"
BR2_ROOTFS_POST_SCRIPT_ARGS="$(BR2_EXTERNAL_minimal_PATH)/board/iso/x86_64/genimage.cfg"

# Linux headers same as kernel, a 4.19 series
BR2_PACKAGE_HOST_LINUX_HEADERS_CUSTOM_4_19=y

# Kernel
BR2_LINUX_KERNEL=y
BR2_LINUX_KERNEL_CUSTOM_VERSION=y
BR2_LINUX_KERNEL_CUSTOM_VERSION_VALUE="4.19.182"
BR2_LINUX_KERNEL_USE_ARCH_DEFAULT_CONFIG=y
BR2_LINUX_KERNEL_NEEDS_HOST_OPENSSL=y

BR2_CCACHE=y

# Packages
BR2_PACKAGE_ACPID=y
```

## deploy/iso/minikube-iso/configs/minikube_aarch64_defconfig
```kconfig
BR2_aarch64=y
BR2_TOOLCHAIN_BUILDROOT_VENDOR="minikube"
BR2_PACKAGE_HOST_LINUX_HEADERS_CUSTOM_6_6=y
BR2_TOOLCHAIN_BUILDROOT_CXX=y
BR2_CCACHE=y
BR2_GLOBAL_PATCH_DIR="$(BR2_EXTERNAL_MINIKUBE_PATH)/patches"
BR2_DOWNLOAD_FORCE_CHECK_HASHES=y
BR2_TARGET_GENERIC_HOSTNAME="minikube"
BR2_TARGET_GENERIC_ISSUE="Welcome to minikube"
BR2_TARGET_GENERIC_PASSWD_SHA512=y
BR2_INIT_SYSTEMD=y
BR2_ROOTFS_DEVICE_TABLE="$(BR2_EXTERNAL_MINIKUBE_PATH)/board/minikube/aarch64/permissions"
BR2_SYSTEM_BIN_SH_BASH=y
BR2_TARGET_GENERIC_GETTY_PORT="tty1"
BR2_SYSTEM_DHCP="eth0"
BR2_ROOTFS_USERS_TABLES="$(BR2_EXTERNAL_MINIKUBE_PATH)/board/minikube/aarch64/users"
BR2_ROOTFS_OVERLAY="$(BR2_EXTERNAL_MINIKUBE_PATH)/board/minikube/aarch64/rootfs-overlay"
BR2_ROOTFS_POST_BUILD_SCRIPT="$(BR2_EXTERNAL_MINIKUBE_PATH)/board/minikube/aarch64/post-build.sh"
BR2_ROOTFS_POST_IMAGE_SCRIPT="$(BR2_EXTERNAL_MINIKUBE_PATH)/board/minikube/aarch64/post-image.sh"
BR2_ROOTFS_POST_SCRIPT_ARGS="$(BR2_EXTERNAL_MINIKUBE_PATH)/board/minikube/aarch64/genimage.cfg"
BR2_LINUX_KERNEL=y
BR2_LINUX_KERNEL_CUSTOM_VERSION=y
BR2_LINUX_KERNEL_CUSTOM_VERSION_VALUE="6.6.95"
BR2_LINUX_KERNEL_USE_CUSTOM_CONFIG=y
BR2_LINUX_KERNEL_CUSTOM_CONFIG_FILE="$(BR2_EXTERNAL_MINIKUBE_PATH)/board/minikube/aarch64/linux_aarch64_defconfig"
BR2_LINUX_KERNEL_LZ4=y
BR2_LINUX_KERNEL_INSTALL_TARGET=y
BR2_LINUX_KERNEL_NEEDS_HOST_OPENSSL=y
BR2_LINUX_KERNEL_NEEDS_HOST_LIBELF=y
BR2_LINUX_KERNEL_NEEDS_HOST_PAHOLE=y
BR2_PACKAGE_GZIP=y
BR2_PACKAGE_XZ=y
BR2_PACKAGE_STRACE=y
BR2_PACKAGE_FINDUTILS=y
BR2_PACKAGE_GIT=y
BR2_PACKAGE_CIFS_UTILS=y
BR2_PACKAGE_E2TOOLS=y
BR2_PACKAGE_NFS_UTILS=y
BR2_PACKAGE_SSHFS=y
BR2_PACKAGE_XFSPROGS=y
BR2_PACKAGE_ACPID=y
BR2_PACKAGE_PARTED=y
BR2_PACKAGE_SYSSTAT=y
BR2_PACKAGE_LZ4=y
BR2_PACKAGE_LZ4_PROGS=y
BR2_PACKAGE_CA_CERTIFICATES=y
BR2_PACKAGE_LIBOPENSSL_BIN=y
BR2_PACKAGE_LIBFUSE=y
BR2_PACKAGE_LIBCURL=y
BR2_PACKAGE_LIBCURL_CURL=y
BR2_PACKAGE_TBB=y
BR2_PACKAGE_BRIDGE_UTILS=y
BR2_PACKAGE_CONNTRACK_TOOLS=y
BR2_PACKAGE_EBTABLES=y
BR2_PACKAGE_ETHTOOL=y
BR2_PACKAGE_IPROUTE2=y
BR2_PACKAGE_IPTABLES=y
BR2_PACKAGE_RSYNC=y
BR2_PACKAGE_SOCAT=y
BR2_PACKAGE_SUDO=y
BR2_PACKAGE_ACL=y
BR2_PACKAGE_COREUTILS=y
BR2_PACKAGE_HTOP=y
BR2_PACKAGE_OPENVMTOOLS=y
BR2_PACKAGE_PROCPS_NG=y
BR2_PACKAGE_PSMISC=y
BR2_PACKAGE_SYSTEMD_LOGIND=y
BR2_PACKAGE_SYSTEMD_MACHINED=y
BR2_PACKAGE_TAR=y
BR2_PACKAGE_UTIL_LINUX_BINARIES=y
BR2_PACKAGE_UTIL_LINUX_LOSETUP=y
BR2_PACKAGE_UTIL_LINUX_NOLOGIN=y
BR2_PACKAGE_UTIL_LINUX_NSENTER=y
BR2_PACKAGE_UTIL_LINUX_SCHEDUTILS=y
BR2_TARGET_ROOTFS_CPIO=y
BR2_TARGET_ROOTFS_CPIO_LZ4=y
# BR2_TARGET_ROOTFS_TAR is not set
BR2_TARGET_GRUB2=y
BR2_TARGET_GRUB2_BUILTIN_MODULES_EFI="boot linux ext2 fat squash4 part_msdos part_gpt normal efi_gop udf iso9660 search search_fs_file search_fs_uuid search_label"
BR2_TARGET_GRUB2_BUILTIN_CONFIG_EFI="$(BR2_EXTERNAL_MINIKUBE_PATH)/board/minikube/aarch64/grub-stub.cfg"
BR2_PACKAGE_HOST_DOSFSTOOLS=y
BR2_PACKAGE_HOST_E2TOOLS=y
BR2_PACKAGE_HOST_GENIMAGE=y
BR2_PACKAGE_HOST_MTOOLS=y
```

## deploy/iso/minikube-iso/configs/minikube_arm1_defconfig
```kconfig
# Architecture
BR2_aarch64=y

# Toolchain, required for eudev and grub
BR2_TOOLCHAIN_BUILDROOT_WCHAR=y

# System
BR2_ROOTFS_DEVICE_CREATION_DYNAMIC_EUDEV=y

## Required tools to create bootable media
BR2_PACKAGE_HOST_DOSFSTOOLS=y
BR2_PACKAGE_HOST_GENIMAGE=y
BR2_PACKAGE_HOST_MTOOLS=y

# Bootloader
BR2_TARGET_GRUB2=y
BR2_TARGET_GRUB2_ARM64_EFI=y

# Filesystem / image
BR2_TARGET_ROOTFS_EXT2=y
BR2_TARGET_ROOTFS_EXT2_4=y
BR2_TARGET_ROOTFS_EXT2_SIZE="200M"

BR2_ROOTFS_POST_IMAGE_SCRIPT="$(BR2_EXTERNAL_MINIKUBE_PATH)/board/iso/aarch64-efi/post-image.sh $(BR2_EXTERNAL_MINIKUBE_PATH)/support/scripts/genimage.sh"
BR2_ROOTFS_POST_SCRIPT_ARGS="-c $(BR2_EXTERNAL_MINIKUBE_PATH)/board/iso/aarch64-efi/genimage-efi.cfg"

# Linux headers same as kernel, a 5.15 series
BR2_PACKAGE_HOST_LINUX_HEADERS_CUSTOM_5_15=y

# Kernel
BR2_LINUX_KERNEL=y
BR2_LINUX_KERNEL_CUSTOM_VERSION=y
BR2_LINUX_KERNEL_CUSTOM_VERSION_VALUE="5.15.4"
BR2_LINUX_KERNEL_USE_ARCH_DEFAULT_CONFIG=y
BR2_LINUX_KERNEL_NEEDS_HOST_OPENSSL=y

# Minikube

BR2_OPTIMIZE_2=y
BR2_GLOBAL_PATCH_DIR="$(BR2_EXTERNAL_MINIKUBE_PATH)/board/coreos/minikube/patches"
BR2_TOOLCHAIN_BUILDROOT_VENDOR="minikube"
BR2_TOOLCHAIN_BUILDROOT_GLIBC=y
BR2_TOOLCHAIN_BUILDROOT_CXX=y
BR2_GCC_ENABLE_LTO=y
BR2_TARGET_GENERIC_HOSTNAME="minikube"
BR2_TARGET_GENERIC_ISSUE="Welcome to minikube"
BR2_TARGET_GENERIC_PASSWD_SHA512=y
BR2_INIT_SYSTEMD=y
BR2_ROOTFS_DEVICE_TABLE="$(BR2_EXTERNAL_MINIKUBE_PATH)/board/coreos/minikube/permissions"
BR2_SYSTEM_BIN_SH_BASH=y
BR2_ROOTFS_USERS_TABLES="$(BR2_EXTERNAL_MINIKUBE_PATH)/board/coreos/minikube/users"
BR2_ROOTFS_OVERLAY="$(BR2_EXTERNAL_MINIKUBE_PATH)/board/coreos/minikube/rootfs-overlay"
BR2_LINUX_KERNEL_USE_CUSTOM_CONFIG=y
BR2_LINUX_KERNEL_CUSTOM_CONFIG_FILE="$(BR2_EXTERNAL_MINIKUBE_PATH)/board/coreos/minikube/linux_defconfig"
BR2_LINUX_KERNEL_LZ4=y
BR2_LINUX_KERNEL_NEEDS_HOST_LIBELF=y
BR2_PACKAGE_GZIP=y
BR2_PACKAGE_XZ=y
BR2_PACKAGE_STRACE=y
BR2_PACKAGE_SYSDIG=y
BR2_PACKAGE_FINDUTILS=y
BR2_PACKAGE_GIT=y
BR2_PACKAGE_CIFS_UTILS=y
BR2_PACKAGE_E2TOOLS=y
BR2_PACKAGE_NFS_UTILS=y
BR2_PACKAGE_SSHFS=y
BR2_PACKAGE_XFSPROGS=y
BR2_PACKAGE_PARTED=y
BR2_PACKAGE_SYSSTAT=y
BR2_PACKAGE_LUAJIT=y
BR2_PACKAGE_LZ4=y
BR2_PACKAGE_LZ4_PROGS=y
BR2_PACKAGE_CA_CERTIFICATES=y
BR2_PACKAGE_LIBOPENSSL_BIN=y
BR2_PACKAGE_LIBCURL_CURL=y
BR2_PACKAGE_BRIDGE_UTILS=y
BR2_PACKAGE_CONNTRACK_TOOLS=y
BR2_PACKAGE_EBTABLES=y
BR2_PACKAGE_ETHTOOL=y
BR2_PACKAGE_IPROUTE2=y
BR2_PACKAGE_IPTABLES=y
BR2_PACKAGE_RSYNC=y
BR2_PACKAGE_SOCAT=y
BR2_PACKAGE_SUDO=y
BR2_PACKAGE_ACL=y
BR2_PACKAGE_COREUTILS=y
BR2_PACKAGE_HTOP=y
BR2_PACKAGE_OPENVMTOOLS=y
BR2_PACKAGE_PROCPS_NG=y
BR2_PACKAGE_PSMISC=y
BR2_PACKAGE_SYSTEMD_LOGIND=y
BR2_PACKAGE_SYSTEMD_MACHINED=y
BR2_PACKAGE_TAR=y
BR2_PACKAGE_UTIL_LINUX_BINARIES=y
BR2_PACKAGE_UTIL_LINUX_LOSETUP=y
BR2_PACKAGE_UTIL_LINUX_NOLOGIN=y
BR2_PACKAGE_UTIL_LINUX_NSENTER=y
BR2_PACKAGE_UTIL_LINUX_SCHEDUTILS=y
BR2_TARGET_ROOTFS_CPIO_GZIP=y
BR2_TARGET_ROOTFS_ISO9660=y
BR2_TARGET_ROOTFS_ISO9660_BOOT_MENU="$(BR2_EXTERNAL_MINIKUBE_PATH)/board/coreos/minikube/isolinux.cfg"
BR2_TARGET_SYSLINUX=y
BR2_PACKAGE_HOST_E2TOOLS=y
BR2_PACKAGE_HOST_PYTHON=y
```
